## target/sdk/Config.in
```kconfig
config SDK
	bool "Build the KOS SDK"
	depends on !EXTERNAL_TOOLCHAIN
	default BUILDBOT
	help
	  This is essentially a stripped-down version of the buildroot
	  with a precompiled toolchain. It can be used to develop and
	  test packages for KOS before including them in the buildroot
```
